## boot/Kconfig
```kconfig
menu "Boot configuration"
    config STACK_SIZE
    default 4096
    int "Stack size for the Debug Console"
endmenu
```

## lib/Kconfig
```kconfig
menu "Library settings"

config PRINTF_BUFFER_SIZE
    default 512
    int "Buffer size of *printf()"
    ---help---
        Size of the buffer for the *printf() style functions in bytes.
endmenu
```

## sys/Kconfig
```kconfig
menu "Debug Console"
    config AUTOBOOT
        bool "Automatically load and launch the hypervisor without user interaction"
        default n
        help
          Skip the interactive debug console and immediately load and launch
          the 64-bit hypervisor core. Useful for automated testing (CI).

    menu "Memory-mappings" 
        config NR_MMAP_MAX_ENTRIES
            default 10
            int "Maximum number of regions displayed on screen"
    endmenu
endmenu

menu "Hypervisor"
    menu "Compression"
        source "sys/xz/Kconfig"
    endmenu

    source "sys/core/Kconfig"
endmenu
```

## sys/core/Kconfig
```kconfig
config HV_OS_STUB
    default yes
    bool "Show warning if executed from an operating system"
    ---help---
        When enabled an OS stub will be compiled in to hvcore.elf64, making
        it properly executable from Linux (at the moment). The binary will
        give an error and exit, as it cannot be used within an operating system.

        Starting hvcore.elf64 in Linux without this option will yield a 
        segmentation fault, therefore it is enabled by default.

config NR_HV_PAGES
    default 16
    int "Number of 2MB pages allocated for the hypervisor"
    ---help---
        The number of physical memory pages allocated for the core hypervisor.
        In the default configuration with 16 2MB pages, this will give 32MB of
        usable memory for all core functionality.

config SZ_HV_STACK
    default 8192
    int "Size of the stack in bytes"
    ---help---
        Size of the fixed stack used by the hypervisor after the memory load.
        Must be a multiple of 4096.

menu "Logging"
    config HV_PHASE_LOG
        default n
        bool "Log SVM exit-code phase transitions"
        ---help---
            Print a one-line trace ("PHASE <from>-><to> cr0=... efer=...
            rip=...") to the debug serial console whenever the guest's SVM
            exit code changes, showing its boot-phase progression.

            Useful when debugging guest boot issues, but adds noise to the
            serial log during normal runs, so it is disabled by default.
endmenu
```
